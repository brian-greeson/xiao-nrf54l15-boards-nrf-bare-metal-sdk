## boards/seeed/bm_xiao_softdevice/Kconfig
```kconfig
#
# Copyright (c) 2025 Nordic Semiconductor
#
# SPDX-License-Identifier: LicenseRef-Nordic-5-Clause
#

config BOARD_BM_XIAO_SOFTDEVICE
	select BOARD_LATE_INIT_HOOK
```

## boards/seeed/bm_xiao_softdevice/Kconfig.bm_xiao_softdevice
```kconfig
#
# Copyright (c) 2025 Nordic Semiconductor
#
# SPDX-License-Identifier: LicenseRef-Nordic-5-Clause
#

config BOARD_BM_XIAO_SOFTDEVICE
	select SOC_NRF54L15_CPUAPP if BOARD_BM_XIAO_SOFTDEVICE_NRF54L15_CPUAPP_S115_SOFTDEVICE
```

## boards/seeed/bm_xiao_softdevice/Kconfig.sysbuild
```kconfig
#
# Copyright (c) 2025 Nordic Semiconductor
#
# SPDX-License-Identifier: LicenseRef-Nordic-5-Clause
#

config PARTITION_MANAGER
	default n

if BOARD_BM_XIAO_SOFTDEVICE_NRF54L15_CPUAPP_S115_SOFTDEVICE

choice SOFTDEVICE_SELECTION
	default SOFTDEVICE_S115
endchoice

endif # BOARD_BM_XIAO_SOFTDEVICE_NRF54L15_CPUAPP_S115_SOFTDEVICE
```

## boards/seeed/bm_xiao_softdevice/board.yml
```yaml
board:
  name: bm_xiao_softdevice
  full_name: Bare Metal XIAO nRF54L15 SoftDevice
  vendor: seeed
  socs:
    - name: nrf54l15
      variants:
        - name: s115_softdevice
          cpucluster: cpuapp
runners:
  run_once:
    '--recover':
      - runners:
          - nrfjprog
          - nrfutil
        run: first
        groups:
          - boards:
              - bm_xiao_softdevice/nrf54l15/cpuapp/s115_softdevice
    '--erase':
      - runners:
          - nrfjprog
          - jlink
          - nrfutil
        run: first
        groups:
          - boards:
              - bm_xiao_softdevice/nrf54l15/cpuapp/s115_softdevice
    '--reset':
      - runners:
          - nrfjprog
          - jlink
          - nrfutil
        run: last
        groups:
          - boards:
              - bm_xiao_softdevice/nrf54l15/cpuapp/s115_softdevice
```
